## drivers/audio/Kconfig.sma1303
```kconfig
# Copyright (c) 2025 Iron Device Corporation
# Copyright (c) 2025 Atmosic
# SPDX-License-Identifier: Apache-2.0

config AUDIO_CODEC_SMA1303
	bool "Iron Device SMA1303 codec support"
	depends on DT_HAS_IRON_SMA1303_ENABLED
	default y
	select I2C if $(dt_compat_on_bus,$(DT_COMPAT_IRON_SMA1303),i2c)
	help
	  Enable driver for SMA1303 amplifier

config SMA1303_PLL
	int "SMA1303 PLL frequency in Hz"
	depends on AUDIO_CODEC_SMA1303
	default 1536000
	range 1411200 24576000
	help
	  Set the PLL frequency for the SMA1303 codec in Hz.
	  Supported frequencies: 1411200, 1536000, 2000000, 3072000,
	  6144000, 12288000, 19200000, 24576000.
	  The driver will select the closest supported frequency.
```
